## common_components/linux_compat/freertos/Kconfig
```kconfig
menu "FreeRTOS"

    config FREERTOS_HZ
        int "configTICK_RATE_HZ"
        range 1 1000
        default 100
        help
            Sets the FreeRTOS tick interrupt frequency in Hz (see configTICK_RATE_HZ in FreeRTOS).

    config FREERTOS_NO_AFFINITY
        hex
        default 0x7FFFFFFF

endmenu
```

## components/asio/Kconfig
```kconfig
menu "ESP-ASIO"
    visible if LWIP_IPV6

    config ASIO_SSL_SUPPORT
        bool "Enable SSL/TLS support of ASIO"
        default n
        help
            Enable support for basic SSL/TLS features, available for mbedTLS/OpenSSL

    config ASIO_SSL_BIO_SIZE
        int "Size of BIO object"
        default 1024
        depends on ASIO_SSL_SUPPORT
        help
            Size in bytes of SSL-BIO implementation.
            Reducing the BIO size saves more RAM, but may slow down input output operations due to
            fragmentation.

endmenu
```

## components/asio/examples/ssl_client_server/sdkconfig.defaults
```kconfig
CONFIG_ASIO_SSL_SUPPORT=y
CONFIG_PARTITION_TABLE_CUSTOM=y
CONFIG_PARTITION_TABLE_CUSTOM_FILENAME="partitions.csv"
CONFIG_PARTITION_TABLE_FILENAME="partitions.csv"
CONFIG_COMPILER_CXX_EXCEPTIONS=y

#
# Partition Table
#
# Leave some room for larger apps without needing to reduce other features
CONFIG_PARTITION_TABLE_SINGLE_APP_LARGE=y
```

## components/asio/tests/build_test/sdkconfig.defaults
```kconfig
CONFIG_COMPILER_OPTIMIZATION_SIZE=y
CONFIG_LWIP_IPV6=y
CONFIG_COMPILER_CXX_EXCEPTIONS=y
```

## components/asio/tests/unit/sdkconfig.defaults
```kconfig
CONFIG_COMPILER_CXX_EXCEPTIONS=y
CONFIG_UNITY_ENABLE_IDF_TEST_RUNNER=n
CONFIG_UNITY_ENABLE_FIXTURE=y
CONFIG_ASIO_SSL_SUPPORT=y
```

## components/console_cmd_ifconfig/Kconfig.projbuild
```kconfig
menu "Enable console commands"

    orsource "$IDF_PATH/examples/common_components/env_caps/$IDF_TARGET/Kconfig.env_caps"

    config EXAMPLE_CMD_QUIT
        bool
        prompt "quit"
        default y
    config EXAMPLE_CMD_IFCONFIG
        bool
        prompt "ifconfig"
        default y
    config EXAMPLE_CMD_PING
        bool
        prompt "ping"
        default n

endmenu
```

## components/console_cmd_mqtt/Kconfig.projbuild
```kconfig
menu "MQTT Configuration"

    config MQTT_CMD_AUTO_REGISTRATION
        bool "Enable Console command mqtt Auto-registration"
        default y
        help
            Enabling this allows for the autoregistration of the wifi command.

    config MQTT_BROKER_URL
        string "Broker URL or IP address"
        default "mqtt://mqtt.eclipseprojects.io"
        help
            URL or IP address of the broker to connect to

endmenu
```

## components/console_cmd_ping/Kconfig.projbuild
```kconfig
menu "Ping command Configuration"

    config PING_CMD_AUTO_REGISTRATION
        bool "Enable Console command ping/dns Auto-registration"
        default y
        help
            Enabling this allows for the autoregistration of the ping and dns commands.

endmenu
```

## components/console_cmd_wifi/Kconfig.projbuild
```kconfig
menu "Wifi command Configuration"

    config WIFI_CMD_AUTO_REGISTRATION
        bool "Enable Console command wifi Auto-registration"
        default y
        help
            Enabling this allows for the autoregistration of the wifi command.

    config WIFI_CMD_NETWORK_SSID
        string "WiFi SSID"
        default "myssid"
        help
            SSID (network name) to connect to.

    config WIFI_CMD_NETWORK_PASSWORD
        string "WiFi Password"
        default "mypassword"
        help
            WiFi password (WPA or WPA2) to use.
            Can be left blank if the network has no security set.

endmenu
```

## components/eppp_link/Kconfig
```kconfig
menu "eppp_link"

    config EPPP_LINK_USES_PPP
        bool "Use PPP network interface"
        default "n"
        select LWIP_PPP_SUPPORT
        select LWIP_PPP_SERVER_SUPPORT
        help
            Enable this option to use PPP network interface.
            This is useful when pairing with another PPP device,
            e.g. pppd service on Linux.
            By default EPPP_LINK uses plain TUN interface,
            relying on transports to split on packet boundaries.

    choice EPPP_LINK_DEVICE
        prompt "Choose PPP device"
        default EPPP_LINK_DEVICE_UART
        help
            Select which peripheral to use for PPP link

        config EPPP_LINK_DEVICE_UART
            bool "UART"
            help
                Use UART.

        config EPPP_LINK_DEVICE_SPI
            bool "SPI"
            help
                Use SPI.

        config EPPP_LINK_DEVICE_SDIO
            bool "SDIO"
            depends on SOC_SDMMC_HOST_SUPPORTED || SOC_SDIO_SLAVE_SUPPORTED
            help
                Use SDIO.

        config EPPP_LINK_DEVICE_ETH
            bool "Ethernet"
            depends on SOC_EMAC_SUPPORTED
            help
                Use Ethernet.
                This transport could employ a full fledged Ethernet connection
                between two EPPP nodes via standard Ethernet cable.
                It could be also effectively connected directly on PCB, EMAC to EMAC,
                without any Ethernet PHY chips (using eth_dummy_phy driver).

    endchoice

    config EPPP_LINK_CONN_MAX_RETRY
        int "Maximum retry"
        default 6
        help
            Set the Maximum retry to infinitely avoid reconnecting
            This is used only with the simplified API (eppp_connect()
            and eppp_listen())

    config EPPP_LINK_PACKET_QUEUE_SIZE
        int "Packet queue size"
        default 64
        depends on EPPP_LINK_DEVICE_SPI
        help
            Size of the Tx packet queue.
            You can decrease the number for slower bit rates.

    choice EPPP_LINK_SDIO_ROLE
        prompt "Choose SDIO host or slave"
        depends on EPPP_LINK_DEVICE_SDIO
        default EPPP_LINK_DEVICE_SDIO_HOST if SOC_SDMMC_HOST_SUPPORTED
        help
            Select which either SDIO host or slave

        config EPPP_LINK_DEVICE_SDIO_HOST
            bool "Host"
            depends on SOC_SDMMC_HOST_SUPPORTED
            help
                Use SDIO host.

        config EPPP_LINK_DEVICE_SDIO_SLAVE
            bool "SLAVE"
            depends on SOC_SDIO_SLAVE_SUPPORTED
            help
                Use SDIO slave.

    endchoice

    config EPPP_LINK_ETHERNET_OUR_ADDRESS
        string "MAC address our local node"
        default "06:00:00:00:00:01"
        depends on EPPP_LINK_DEVICE_ETH

    config EPPP_LINK_ETHERNET_THEIR_ADDRESS
        string "MAC address the remote node"
        default "06:00:00:00:00:02"
        depends on EPPP_LINK_DEVICE_ETH

    config EPPP_LINK_CHANNELS_SUPPORT
        bool "Enable channel support (multiple logical channels)"
        default n
        depends on !EPPP_LINK_DEVICE_ETH
        help
            Enable support for multiple logical channels in the EPPP link layer.
            When enabled, you can configure the number of channels used for communication.

    config EPPP_LINK_NR_OF_CHANNELS
        int "Number of logical channels"
        depends on EPPP_LINK_CHANNELS_SUPPORT && !EPPP_LINK_DEVICE_ETH
        range 1 8
        default 2
        help
            Set the number of logical channels for EPPP link communication.
            Each channel can be used for independent data streams.

endmenu
```

## components/eppp_link/examples/emac2emac/main/Kconfig.projbuild
```kconfig
menu "Example Configuration"

    choice EXAMPLE_NODE_ROLE
        prompt "Choose the device role"
        default EXAMPLE_NODE_SERVER
        help
            Select whether this device acts as a server or a client

        config EXAMPLE_NODE_SERVER
            bool "Server"
            help
                Act as an EPPP server, source RMII clock

        config EXAMPLE_NODE_CLIENT
            bool "Client"
            help
                Act as an EPPP client, use server's clock

    endchoice

    config EXAMPLE_RMII_CLK_READY_GPIO
        int "RMII CLK Sink Device is ready GPIO"
        default 4
        help
            GPIO number at which the "RMII CLK Sink Device" is ready and so the "RMII
            CLK Source Device" can continue in its Ethernet initialization.

endmenu
```

## components/eppp_link/examples/emac2emac/sdkconfig.defaults
```kconfig
CONFIG_IDF_TARGET="esp32"
CONFIG_LWIP_PPP_SUPPORT=y
CONFIG_LWIP_PPP_SERVER_SUPPORT=y
CONFIG_LWIP_PPP_VJ_HEADER_COMPRESSION=n
CONFIG_LWIP_PPP_DEBUG_ON=y
CONFIG_EPPP_LINK_DEVICE_ETH=y
```

## components/eppp_link/examples/host/main/Kconfig.projbuild
```kconfig
menu "Example Configuration"

    config EXAMPLE_GLOBAL_DNS
        hex "Set global DNS server"
        range 0 0xFFFFFFFF
        default 0x08080808
        help
            Global DNS server address.

    config EXAMPLE_MQTT
        bool "Run mqtt example"
        default y
        help
            Run MQTT client after startup.

    config EXAMPLE_BROKER_URL
        string "Broker URL"
        depends on EXAMPLE_MQTT
        default "mqtt://mqtt.eclipseprojects.io"
        help
            URL of the broker to connect to.

    config EXAMPLE_IPERF
        bool "Run iperf"
        default y
        help
            Init and run iperf console.

    config EXAMPLE_SPI_HOST
        int "SPI Host"
        depends on EPPP_LINK_DEVICE_SPI
        default 1
        range 0 2
        help
            SPI host to use (SPI1_HOST=0, SPI2_HOST=1, SPI3_HOST=2).

    config EXAMPLE_SPI_MOSI_PIN
        int "MOSI Pin Number"
        depends on EPPP_LINK_DEVICE_SPI
        default 23
        range 0 39
        help
            Pin number of SPI MOSI.

    config EXAMPLE_SPI_MISO_PIN
        int "MISO Pin Number"
        depends on EPPP_LINK_DEVICE_SPI
        default 19
        range 0 39
        help
            Pin number of SPI MISO.

    config EXAMPLE_SPI_SCLK_PIN
        int "SCLK Pin Number"
        depends on EPPP_LINK_DEVICE_SPI
        default 18
        range 0 39
        help
            Pin number of SPI SCLK.

    config EXAMPLE_SPI_CS_PIN
        int "CS Pin Number"
        depends on EPPP_LINK_DEVICE_SPI
        default 5
        range 0 39
        help
            Pin number of SPI CS.

    config EXAMPLE_SPI_INTR_PIN
        int "Interrupt Pin Number"
        depends on EPPP_LINK_DEVICE_SPI
        default 17
        range 0 39
        help
            Pin number of SPI interrupt.

    config EXAMPLE_SPI_FREQUENCY
        int "SPI Frequency (Hz)"
        depends on EPPP_LINK_DEVICE_SPI
        default 4000000
        range 100000 80000000
        help
            SPI frequency in Hz.

    config EXAMPLE_UART_TX_PIN
        int "TXD Pin Number"
        depends on EPPP_LINK_DEVICE_UART
        default 17
        range 0 31
        help
            Pin number of UART TX.

    config EXAMPLE_UART_RX_PIN
        int "RXD Pin Number"
        depends on EPPP_LINK_DEVICE_UART
        default 18
        range 0 31
        help
            Pin number of UART RX.

    config EXAMPLE_UART_BAUDRATE
        int "Baudrate"
        depends on EPPP_LINK_DEVICE_UART
        default 921600
        range 0 4000000
        help
            Baudrate used by the PPP over UART

endmenu
```

## components/eppp_link/examples/slave/main/Kconfig.projbuild
```kconfig
menu "Example Configuration"

    config ESP_WIFI_SSID
        string "WiFi SSID"
        default "myssid"
        help
            SSID (network name) for the example to connect to.

    config ESP_WIFI_PASSWORD
        string "WiFi Password"
        default "mypassword"
        help
            WiFi password (WPA or WPA2) for the example to use.

    config ESP_MAXIMUM_RETRY
        int "Maximum retry"
        default 5
        help
            Set the Maximum retry to avoid station reconnecting to the AP unlimited when the AP is really inexistent.

    config EXAMPLE_UART_TX_PIN
        int "TXD Pin Number"
        depends on EPPP_LINK_DEVICE_UART
        default 11
        range 0 31
        help
            Pin number of UART TX.

    config EXAMPLE_UART_RX_PIN
        int "RXD Pin Number"
        depends on EPPP_LINK_DEVICE_UART
        default 10
        range 0 31
        help
            Pin number of UART RX.

    config EXAMPLE_UART_BAUDRATE
        int "Baudrate"
        depends on EPPP_LINK_DEVICE_UART
        default 2000000
        range 0 4000000
        help
            Baudrate used by the PPP over UART

endmenu
```

## components/eppp_link/examples/slave/sdkconfig.defaults
```kconfig
CONFIG_LWIP_IP_FORWARD=y
CONFIG_LWIP_IPV4_NAPT=y
CONFIG_LWIP_TCPIP_TASK_STACK_SIZE=4096
```

## components/eppp_link/examples/slave_wifi_rest_api/main/Kconfig.projbuild
```kconfig
menu "Example Configuration"

    config ESP_WIFI_SSID
        string "WiFi SSID"
        default "myssid"
        help
            SSID (network name) for the example to connect to.

    config ESP_WIFI_PASSWORD
        string "WiFi Password"
        default "mypassword"
        help
            WiFi password (WPA or WPA2) for the example to use.

    config ESP_MAXIMUM_RETRY
        int "Maximum retry"
        default 5
        help
            Set the Maximum retry to avoid station reconnecting to the AP unlimited when the AP is really inexistent.

    config EXAMPLE_SPI_HOST
        int "SPI Host"
        depends on EPPP_LINK_DEVICE_SPI
        default 1
        range 0 2
        help
            SPI host to use (SPI1_HOST=0, SPI2_HOST=1, SPI3_HOST=2).

    config EXAMPLE_SPI_MOSI_PIN
        int "MOSI Pin Number"
        depends on EPPP_LINK_DEVICE_SPI
        default 23
        range 0 39
        help
            Pin number of SPI MOSI.

    config EXAMPLE_SPI_MISO_PIN
        int "MISO Pin Number"
        depends on EPPP_LINK_DEVICE_SPI
        default 19
        range 0 39
        help
            Pin number of SPI MISO.

    config EXAMPLE_SPI_SCLK_PIN
        int "SCLK Pin Number"
        depends on EPPP_LINK_DEVICE_SPI
        default 18
        range 0 39
        help
            Pin number of SPI SCLK.

    config EXAMPLE_SPI_CS_PIN
        int "CS Pin Number"
        depends on EPPP_LINK_DEVICE_SPI
        default 5
        range 0 39
        help
            Pin number of SPI CS.

    config EXAMPLE_SPI_INTR_PIN
        int "Interrupt Pin Number"
        depends on EPPP_LINK_DEVICE_SPI
        default 17
        range 0 39
        help
            Pin number of SPI interrupt.

    config EXAMPLE_SPI_FREQUENCY
        int "SPI Frequency (Hz)"
        depends on EPPP_LINK_DEVICE_SPI
        default 1000000
        range 100000 80000000
        help
            SPI frequency in Hz.

    config EXAMPLE_UART_TX_PIN
        int "TXD Pin Number"
        depends on EPPP_LINK_DEVICE_UART
        default 18
        range 0 31
        help
            Pin number of UART TX.

    config EXAMPLE_UART_RX_PIN
        int "RXD Pin Number"
        depends on EPPP_LINK_DEVICE_UART
        default 17
        range 0 31
        help
            Pin number of UART RX.

    config EXAMPLE_UART_BAUDRATE
        int "Baudrate"
        depends on EPPP_LINK_DEVICE_UART
        default 921600
        range 0 4000000
        help
            Baudrate used by the PPP over UART

    config EXAMPLE_WIFI_OVER_EPPP_CHANNEL
        bool "Use WiFi over EPPP channel"
        default n
        depends on EPPP_LINK_CHANNELS_SUPPORT
        help
            Enable this option to use WiFi over EPPP channel.
            If this option is enabled, the example will only start the Wi-Fi driver,
            but the Wi-Fi netif will reside on client's end and will channel
            the Rx and Tx data via EPPP channels.

endmenu
```

## components/eppp_link/test/test_app/sdkconfig.defaults
```kconfig
CONFIG_IDF_TARGET="esp32"
CONFIG_UART_ISR_IN_IRAM=y
CONFIG_ESP_NETIF_IP_LOST_TIMER_INTERVAL=0
CONFIG_FREERTOS_UNICORE=y
CONFIG_LWIP_PPP_SUPPORT=y
CONFIG_LWIP_PPP_SERVER_SUPPORT=y
CONFIG_LWIP_PPP_VJ_HEADER_COMPRESSION=n
CONFIG_LWIP_PPP_DEBUG_ON=y
CONFIG_UNITY_ENABLE_FIXTURE=y
```
