## components/esp_dns/Kconfig
```kconfig
menu "ESP DNS"

    config ESP_DNS_MAX_ANSWER_SCAN
        int "Maximum resource records to scan per DNS response"
        range 1 128
        default 16
        help
            Maximum number of answer-section resource records to walk when parsing
            a DNS response. This limit is independent of MAX_ANSWERS (fixed at 1
            until the lwIP external-resolve hook passes addr_cnt).

            Increase this value for long CNAME chains or responses with many
            non-address records before the desired A/AAAA records.

    config ESP_DNS_BUFFER_SIZE
        int "DNS response/query buffer size in bytes"
        range 512 4096
        default 512
        help
            Size of stack buffers used for DNS queries and responses in TCP,
            DNS-over-TLS, and DNS-over-HTTPS paths. The default of 512 bytes
            matches the traditional DNS UDP message size limit from RFC 1035.

            Increase this value if you expect larger responses (for example
            with EDNS0), keeping in mind the impact on task stack usage.

endmenu
```

## components/esp_dns/examples/esp_dns_basic/main/Kconfig.projbuild
```kconfig
menu "Example Configuration"

    config EXAMPLE_DNS_ADDRINFO_TASK_STACK
        int "getaddrinfo worker task stack size (bytes)"
        range 4096 32768
        default 8192
        help
            Stack size for the FreeRTOS task that runs getaddrinfo() in this example.
            DoT/DoH resolution pulls in mbedTLS; 4 KiB is too small on typical builds.

endmenu
```

## components/esp_dns/tests/test_apps/esp_dns_concurrent/sdkconfig.defaults
```kconfig
# SPDX-FileCopyrightText: 2026 Espressif Systems (Shanghai) CO LTD
#
# SPDX-License-Identifier: CC0-1.0
#
# Minimal options so esp_dns lwIP hook and getaddrinfo stress test work.
CONFIG_PARTITION_TABLE_SINGLE_APP_LARGE=y
CONFIG_LWIP_DNS_MAX_HOST_IP=4
CONFIG_LWIP_USE_ESP_GETADDRINFO=y
CONFIG_LWIP_HOOK_NETCONN_EXT_RESOLVE_CUSTOM=y
CONFIG_MBEDTLS_CERTIFICATE_BUNDLE=y
CONFIG_MBEDTLS_CERTIFICATE_BUNDLE_DEFAULT_FULL=y
CONFIG_MBEDTLS_CERTIFICATE_BUNDLE_CROSS_SIGNED_VERIFY=y
```
