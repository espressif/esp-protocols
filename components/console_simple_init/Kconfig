## components/console_simple_init/Kconfig
```kconfig
menu "Simple Console Initializer"

    config CONSOLE_SIMPLE_INIT_ENABLE_STOP
        bool "Enable console_cmd_stop()"
        default n
        help
            Compile console_cmd_stop() so the REPL can be torn down at runtime.
            Disabled by default because referencing esp_console_stop_repl()
            pulls IDF's non-blocking linenoise / eventfd stop path into the
            link and changes console read behavior.

endmenu
```

## components/esp_websocket_client/Kconfig
```kconfig
menu "ESP WebSocket client"

    config ESP_WS_CLIENT_ENABLE_DYNAMIC_BUFFER
        bool "Enable websocket client dynamic buffer for send and receive data"
        default n
        help
            Enable this option will reallocated buffer when send or receive data and free them when end of use.
            This can save about 2 KB memory when no websocket data send and receive.

    config ESP_WS_CLIENT_SEPARATE_TX_LOCK
        bool "Enable separate tx lock for send and receive data"
        default n
        help
            Enable this option will use separate lock for send and receive data.
            This can avoid the lock contention when send and receive data at the same time.

    config ESP_WS_CLIENT_TX_LOCK_TIMEOUT_MS
        int "TX lock timeout in milliseconds"
        depends on ESP_WS_CLIENT_SEPARATE_TX_LOCK
        default 2000
        help
            Timeout for acquiring the TX lock when using separate TX lock.
    config ESP_WS_CLIENT_ALLOC_IN_EXT_RAM
        bool "Allocate WebSocket client structures in PSRAM"
        default n
        depends on SPIRAM
        depends on (SPIRAM_USE_CAPS_ALLOC || SPIRAM_USE_MALLOC)
        help
            Allocate the main esp_websocket_client structure and its internal
            configuration storage in external RAM (PSRAM).

            This option does not move duplicated configuration strings, RX/TX
            buffers, transports, event groups, mutexes, or other internal
            allocations to PSRAM.

            If PSRAM allocation fails, esp_websocket_client_init() returns NULL.
            There is no fallback to internal RAM.

    config ESP_WS_CLIENT_TASK_STACK_IN_EXT_RAM
        bool "Allocate WebSocket task stack in PSRAM"
        default n
        depends on SPIRAM
        depends on (SPIRAM_USE_CAPS_ALLOC || SPIRAM_USE_MALLOC)
        depends on FREERTOS_SUPPORT_STATIC_ALLOCATION
        depends on (FREERTOS_TASK_CREATE_ALLOW_EXT_MEM || SPIRAM_ALLOW_STACK_EXTERNAL_MEMORY)
        help
            Allocate the WebSocket task stack in external RAM (PSRAM) using
            xTaskCreatePinnedToCoreWithCaps().

            Only the task stack is allocated in PSRAM. The task control block
            (TCB) remains in internal RAM.

            This implementation requires ESP-IDF v5.3.1 or newer because the
            WebSocket task self-deletes using vTaskDeleteWithCaps(NULL).

            If PSRAM stack allocation fails,
            esp_websocket_client_start() returns ESP_FAIL. There is no fallback
            to an internal-RAM task stack.

            External memory is inaccessible while the flash cache is disabled, so with this option
            the WebSocket task must not run any code that disables the cache. In particular, flash and
            NVS operations, and entering deep or light sleep, are not allowed from the WebSocket task
            context. This includes user code running in an event handler dispatched by the WebSocket
            task.
endmenu
```
