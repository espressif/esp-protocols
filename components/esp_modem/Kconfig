## components/esp_modem/Kconfig
```kconfig
menu "esp-modem"

    config ESP_MODEM_CMUX_DEFRAGMENT_PAYLOAD
        bool "Defragment CMUX messages internally"
        default y
        help
            If enabled (default), the esp-modem automatically defragments CMUX messages
            to only pass the completed CMUX message to higher layers.
            This is useful for messages in command mode (if they're received fragmented).
            It's not a problem for messages in data mode as the upper layer (PPP protocol)
            defines message boundaries.
            Keep the default to true for most cases (as most devices use simply 1 byte CMUX
            length, as the internal Rx buffer of size >= 256 bytes won't overflow)
            Set to false if your devices uses 2 byte CMUX payload (e.g. A7672S).
            The operation would work without an issue in data mode, but some replies
            in command mode might come fragmented in rare cases so might need to retry
            AT commands.

    config ESP_MODEM_USE_INFLATABLE_BUFFER_IF_NEEDED
        bool "Use inflatable buffer in DCE"
        default n
        help
            If enabled we will process the ongoing AT command by growing the current
            buffer (if we've run out the preconfigured buffer).
            If disabled, we simply report a failure.
            Use this if additional allocation is not a problem and you need to reliably process
            all commands, usually with sporadically longer responses than the configured buffer.
            Could be also used to defragment AT replies in CMUX mode if CMUX_DEFRAGMENT_PAYLOAD=n

    config ESP_MODEM_CMUX_DELAY_AFTER_DLCI_SETUP
        int "Delay in ms to wait before creating another virtual terminal"
        default 0
        help
            Some devices might need a pause before sending SABM command that creates
            virtual terminal. This delay applies only to establishing a CMUX mode.
            The typical reason for failing SABM request without a delay is that
            some devices (SIM800) send MSC requests just after opening a new DLCI.

    config ESP_MODEM_CMUX_USE_SHORT_PAYLOADS_ONLY
        bool "CMUX to support only short payloads (<128 bytes)"
        default n
        help
            If enabled, the CMUX protocol would only use 1 byte size field.
            You can use this option for devices that support only short CMUX payloads
            to make the protocol more robust on noisy environments or when underlying
            transport gets corrupted often (for example by Rx buffer overflows)

    config ESP_MODEM_ADD_CUSTOM_MODULE
        bool "Add support for custom module in C-API"
        default n
        help
            If enabled, we adapt the C-API to create a DCE from a user defined class

    config ESP_MODEM_CUSTOM_MODULE_HEADER
        string "Header file name which defines custom DCE creation"
        depends on ESP_MODEM_ADD_CUSTOM_MODULE
        default "custom_module.hpp"
        help
            Name of the header file in the main component which implements esp_modem_create_custom_dce()
            called from C-API for creating esp_modem_dce object.
            This header provides definition of the custom module with some additional and/or updated commands
            and API. It also defines creation of DCE based on this custom module, typically calling:
            dce_factory::Factory::create_unique_dce_from<CustomModule, DCE*>(dce_config, std::move(dte), netif)
            Please refer to the pppos_client example for more details.

endmenu
```

## components/esp_modem/examples/modem_console/main/Kconfig.projbuild
```kconfig
menu "Example Configuration"

    choice EXAMPLE_SERIAL_CONFIG
        prompt "Type of serial connection to the modem"
        default EXAMPLE_SERIAL_CONFIG_UART
        config EXAMPLE_SERIAL_CONFIG_UART
            bool "UART"
            help
                Connect to modem via UART.
        config EXAMPLE_SERIAL_CONFIG_USB
            bool "USB"
            depends on IDF_TARGET_ESP32S2 || IDF_TARGET_ESP32S3
            help
                Connect to modem via USB (CDC-ACM class). For IDF version >= 4.4.
    endchoice
endmenu
```

## components/esp_modem/examples/simple_cmux_client/sdkconfig.defaults
```kconfig
# Override some defaults to enable PPP
CONFIG_LWIP_PPP_SUPPORT=y
CONFIG_LWIP_PPP_NOTIFY_PHASE_SUPPORT=y
CONFIG_LWIP_PPP_PAP_SUPPORT=y
CONFIG_LWIP_TCPIP_TASK_STACK_SIZE=4096
CONFIG_LWIP_PPP_ENABLE_IPV6=n
CONFIG_COMPILER_CXX_EXCEPTIONS=y
CONFIG_PARTITION_TABLE_TWO_OTA=y
CONFIG_ESPTOOLPY_FLASHSIZE_4MB=y
CONFIG_NEWLIB_STDOUT_LINE_ENDING_LF=y
CONFIG_NEWLIB_STDIN_LINE_ENDING_LF=y
CONFIG_ESP_MAIN_TASK_STACK_SIZE=8192
```

## components/esp_modem/test/target/main/Kconfig.projbuild
```kconfig
menu "Test App Configuration"

    config TEST_APP_PPP_SERVER_IP
        string "IP address of PPP server"
        default "10.0.0.1"
        help
            IP address of PPP server. Note: this is also the address
            where the TCP server is started to test the connection

    config TEST_APP_PPP_CLIENT_IP
        string "IP address of PPP client"
        default "10.0.0.2"
        help
            IP address that PPP server assigns to PPP client.

    config TEST_APP_UART_TX_PIN
        int "TXD Pin Number"
        default 6
        range 0 31
        help
            Pin number of UART TX.

    config TEST_APP_UART_RX_PIN
        int "RXD Pin Number"
        default 7
        range 0 31
        help
            Pin number of UART RX.

    config TEST_APP_TCP_PORT
        int "Port of test"
        range 0 65535
        default 2222
        help
            The remote port to which the client will connects to
            once the PPP connection established

endmenu
```

## components/esp_modem/test/target_iperf/sdkconfig.defaults
```kconfig
CONFIG_COMPILER_CXX_EXCEPTIONS=y
CONFIG_LWIP_PPP_SUPPORT=y
CONFIG_ESP_MAIN_TASK_STACK_SIZE=4096
```

## components/esp_modem/test/target_ota/sdkconfig.defaults
```kconfig
CONFIG_ESPTOOLPY_FLASHSIZE_4MB=y
CONFIG_PARTITION_TABLE_TWO_OTA=y
CONFIG_COMPILER_CXX_EXCEPTIONS=y
# This is not supported in IDF yet
# CONFIG_ESP_HTTP_CLIENT_ENABLE_CUSTOM_TRANSPORT=y
CONFIG_ESP_SYSTEM_PANIC_PRINT_HALT=y
CONFIG_ESP_MAIN_TASK_STACK_SIZE=8192
CONFIG_LWIP_PPP_SUPPORT=y
CONFIG_LWIP_PPP_ENABLE_IPV6=n
CONFIG_LWIP_ENABLE_LCP_ECHO=y
CONFIG_LWIP_LCP_ECHOINTERVAL=1
CONFIG_LWIP_LCP_MAXECHOFAILS=2
```

## components/esp_modem/test/target_urc/sdkconfig.defaults
```kconfig
CONFIG_COMPILER_CXX_EXCEPTIONS=y
CONFIG_LWIP_PPP_SUPPORT=y
CONFIG_ESP_MODEM_URC_HANDLER=y
```

## components/esp_mqtt_cxx/examples/ssl/main/Kconfig.projbuild
```kconfig
menu "Example Configuration"

    config BROKER_URI
        string "Broker URL"
        default "mqtts://mqtt.eclipseprojects.io:8883"
        help
            URL of the broker to connect to

endmenu
```

## components/esp_mqtt_cxx/examples/ssl/sdkconfig.defaults
```kconfig
# Enable C++ exceptions and set emergency pool size for exception objects
CONFIG_COMPILER_CXX_EXCEPTIONS=y
CONFIG_COMPILER_CXX_EXCEPTIONS_EMG_POOL_SIZE=1024
CONFIG_EXAMPLE_CONNECT_ETHERNET=y
CONFIG_EXAMPLE_CONNECT_WIFI=n
CONFIG_EXAMPLE_USE_INTERNAL_ETHERNET=y
CONFIG_EXAMPLE_ETH_PHY_IP101=y
CONFIG_EXAMPLE_ETH_MDC_GPIO=23
CONFIG_EXAMPLE_ETH_MDIO_GPIO=18
CONFIG_EXAMPLE_ETH_PHY_RST_GPIO=5
CONFIG_EXAMPLE_ETH_PHY_ADDR=1
CONFIG_EXAMPLE_CONNECT_IPV6=y
CONFIG_EXAMPLE_CONNECT_ETHERNET=y
CONFIG_EXAMPLE_CONNECT_WIFI=n
CONFIG_EXAMPLE_USE_INTERNAL_ETHERNET=y
CONFIG_EXAMPLE_ETH_PHY_IP101=y
CONFIG_EXAMPLE_ETH_MDC_GPIO=23
CONFIG_EXAMPLE_ETH_MDIO_GPIO=18
CONFIG_EXAMPLE_ETH_PHY_RST_GPIO=5
CONFIG_EXAMPLE_ETH_PHY_ADDR=1
CONFIG_EXAMPLE_CONNECT_IPV6=y
```

## components/esp_websocket_client/examples/linux/main/Kconfig.projbuild
```kconfig
menu "Host-test config"

    config GCOV_ENABLED
        bool "Coverage analyzer"
        default n
        help
            Enables coverage analyzing for host tests.

    config WEBSOCKET_URI
          string "Websocket endpoint URI"
          default "wss://echo.websocket.org"
          help
              URL of websocket endpoint this example connects to and sends echo

    config WS_OVER_TLS_SERVER_AUTH
        bool "Enable WebSocket over TLS with Server Certificate Verification Only"
        default y
        help
            Enables WebSocket connections over TLS (WSS) with server certificate verification.
            The client verifies the server certificate; the server does not require a client certificate.

    config WS_OVER_TLS_MUTUAL_AUTH
        bool "Enable WebSocket over TLS with Server Client Mutual Authentification"
        default n
        help
            Enables WebSocket connections over TLS (WSS) with server and client mutual certificate verification.

    config WS_OVER_TLS_SKIP_COMMON_NAME_CHECK
        bool "Skip common name(CN) check during TLS authentification"
        default n
        help
            Skip Common Name (CN) check during TLS (WSS) authentication. Use only for testing.

endmenu
```

## components/esp_websocket_client/tests/autobahn-testsuite/testee/main/Kconfig.projbuild
```kconfig
menu "Autobahn Testsuite Configuration"

    choice WEBSOCKET_URI_SOURCE
        prompt "Autobahn Server URI Source"
        default WEBSOCKET_URI_FROM_STRING
        help
            Choose how the Autobahn server URI is provided:
            - From string: Use CONFIG_AUTOBAHN_SERVER_URI (compile-time)
            - From stdin: Read URI from stdin (serial console at runtime)

        config WEBSOCKET_URI_FROM_STRING
            bool "From string (CONFIG_AUTOBAHN_SERVER_URI)"
            help
                Use the URI defined in CONFIG_AUTOBAHN_SERVER_URI.
                This is set at compile time.

        config WEBSOCKET_URI_FROM_STDIN
            bool "From stdin (serial console)"
            help
                Read the URI from stdin (serial console) at runtime.
                Useful for CI/CD where the server IP is only known at runtime.
                The application will wait for a line containing the URI.

    endchoice

    config AUTOBAHN_SERVER_URI
        string "Autobahn Fuzzing Server URI"
        default "ws://192.168.1.100:9001"
        depends on WEBSOCKET_URI_FROM_STRING
        help
            URI of the Autobahn fuzzing server.
            Replace with your Docker host IP address.
            Example: ws://192.168.1.100:9001
            Only used when WEBSOCKET_URI_FROM_STRING is selected.

    if CONFIG_IDF_TARGET = "linux"
        config GCOV_ENABLED
            bool "Coverage analyzer"
            default n
            help
                Enables coverage analyzing for host tests.
    endif

endmenu
```

## components/esp_wifi_remote/Kconfig
```kconfig
menu "Wi-Fi Remote"
    config ESP_WIFI_REMOTE_ENABLED
        bool
        default y

    orsource "./idf_v$ESP_IDF_VERSION/Kconfig.slave_select.in"
    orsource "./idf_v$ESP_IDF_VERSION/Kconfig.soc_wifi_caps.in"
    orsource "./Kconfig.rpc.in"

    menu "Wi-Fi configuration"
    orsource "./idf_v$ESP_IDF_VERSION/Kconfig.wifi.in"
    endmenu

endmenu # Wi-Fi Remote
```

## components/esp_wifi_remote/Kconfig.rpc.in
```kconfig
choice ESP_WIFI_REMOTE_LIBRARY
    prompt "Choose WiFi-remote implementation"
    default ESP_WIFI_REMOTE_LIBRARY_EPPP
    help
        Select type of WiFi Remote implementation

        ESP-HOSTED is the default and most versatile option.
        It's also possible to use EPPP, which uses PPPoS link between micros and NAPT, so it's slower
        and less universal.

    config ESP_WIFI_REMOTE_LIBRARY_HOSTED
        bool "ESP-HOSTED"
    config ESP_WIFI_REMOTE_LIBRARY_EPPP
        bool "EPPP"
endchoice

    if ESP_WIFI_REMOTE_LIBRARY_EPPP

        config ESP_WIFI_REMOTE_EPPP_UART_TX_PIN
            int "TXD Pin Number"
            default 10
            range 0 31
            help
                Pin number of UART TX.

        config ESP_WIFI_REMOTE_EPPP_UART_RX_PIN
            int "RXD Pin Number"
            default 11
            range 0 31
            help
                Pin number of UART RX.

        config ESP_WIFI_REMOTE_EPPP_SERVER_CA
            string "Servers CA certificate"
            default "--- Please copy content of the CA certificate ---"

        config ESP_WIFI_REMOTE_EPPP_CLIENT_CRT
            string "Client certificate"
            default "--- Please copy content of the Client certificate ---"

        config ESP_WIFI_REMOTE_EPPP_CLIENT_KEY
            string "Client key"
            default "--- Please copy content of the Client key ---"

        config ESP_WIFI_REMOTE_EPPP_CLIENT_CA
            string "Clients CA certificate"
            default "--- Please copy content of the CA certificate ---"

        config ESP_WIFI_REMOTE_EPPP_SERVER_CRT
            string "Server certificate"
            default "--- Please copy content of the Client certificate ---"

        config ESP_WIFI_REMOTE_EPPP_SERVER_KEY
            string "Server key"
            default "--- Please copy content of the Client key ---"

    endif
```

## components/esp_wifi_remote/examples/mqtt/sdkconfig.defaults.esp32h2
```kconfig
CONFIG_IDF_TARGET="esp32h2"
CONFIG_EXAMPLE_CONNECT_WIFI=n
CONFIG_EXAMPLE_CONNECT_ETHERNET=y
```

## components/freertos_tcp/Kconfig
```kconfig
menu "Amazon FreeRTOS plus TCP (AFpT)"

    config AFPT_ENABLE
        bool
        default y
        select ESP_NETIF_PROVIDE_CUSTOM_IMPLEMENTATION

    config AFPT_LOCAL_HOSTNAME
        string "Local netif hostname"
        default 'espressif'
        help
            The default name this device will report to other devices on the network.
            Could be updated at runtime with esp_netif_set_hostname()

    config AFPT_IPV4
        bool "Enable IPv4"
        default y
        help
            Enable IPv4 stack. If you want to use IPv6 only TCP/IP stack, disable this.

    config AFPT_IPV6
        bool "Enable IPv6"
        default n
        help
            Enable IPv6 function (Experimental - not included in MVP).
            For MVP, use IPv4 only stack. If you want to use IPv4 only TCP/IP stack, disable this.

endmenu
```

## components/freertos_tcp/examples/simple/main/Kconfig.projbuild
```kconfig
menu "Example Configuration"

    config EXAMPLE_HOSTNAME
        string "hostname to connect to"
        default "httpbin.org"
        help
            The example will connect to this hostname.

    config EXAMPLE_PORT
        int "Port"
        range 0 65535
        default 80
        help
            The remote port to which the client example will connect to.

endmenu
```

## components/freertos_tcp/test_app/main/Kconfig.projbuild
```kconfig
menu "FreeRTOS TCP Test Configuration"

    config ESP_WIFI_SSID
        string "WiFi SSID"
        default "myssid"
        help
            SSID (network name) for the test to connect to.

    config ESP_WIFI_PASSWORD
        string "WiFi Password"
        default "mypassword"
        help
            WiFi password (WPA or WPA2) for the test to use.

    config TEST_TCP_SERVER_IP
        string "Test TCP Server IP"
        default "93.184.216.34"
        help
            IP address of TCP server to connect to for testing (default: example.com).

    config TEST_TCP_SERVER_PORT
        int "Test TCP Server Port"
        default 80
        help
            Port of TCP server to connect to for testing.

    config TEST_DNS_HOSTNAME
        string "Test DNS Hostname"
        default "example.com"
        help
            Hostname to resolve for DNS testing.

endmenu
```
