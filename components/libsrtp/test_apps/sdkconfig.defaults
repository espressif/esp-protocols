## esp_modem/examples/simple_cmux_client/main/Kconfig.projbuild
```kconfig
menu "Example Configuration"

    choice EXAMPLE_MODEM_DEVICE
        prompt "Choose supported modem device (DCE)"
        default EXAMPLE_MODEM_DEVICE_BG96
        help
            Select modem device connected to the ESP DTE.
        config EXAMPLE_MODEM_DEVICE_SIM800
            bool "SIM800"
            help
                SIMCom SIM800L is a GSM/GPRS module.
                It supports Quad-band 850/900/1800/1900MHz.
        config EXAMPLE_MODEM_DEVICE_BG96
            bool "BG96"
            help
                Quectel BG96 is a series of LTE Cat M1/Cat NB1/EGPRS module.
        config EXAMPLE_MODEM_DEVICE_SIM7600
            bool "SIM7600"
            help
                SIM7600 is a Multi-Band LTE-TDD/LTE-FDD/HSPA+ and GSM/GPRS/EDGE module.
    endchoice

    config EXAMPLE_MODEM_PPP_APN
        string "Set MODEM APN"
        default "internet"
        help
            Set APN (Access Point Name), a logical name to choose data network

    config EXAMPLE_NEED_SIM_PIN
        bool "SIM PIN needed"
        default n
        help
            Enable to set SIM PIN before starting the example

    config EXAMPLE_SIM_PIN
        string "Set SIM PIN"
        default "1234"
        depends on EXAMPLE_NEED_SIM_PIN
        help
            Pin to unlock the SIM

    config EXAMPLE_USE_VFS_TERM
        bool "Use VFS terminal"
        default n
        help
            Demonstrate use of VFS as a communication terminal of the DTE.
            VFS driver implements non-block reads, writes and selects to communicate with esp-modem,
            but this implementation uses UART resource only.

    config EXAMPLE_PERFORM_OTA
        bool "Perform OTA in the example"
        default n
        help
            Perform the OTA update after connecting to the network and mqtt broker.
            This option is used only to exercise network stability in CMUX mode.

    config EXAMPLE_PERFORM_OTA_URI
        string "URI of the binary"
        default "https://my.code/esp32.bin"
        depends on EXAMPLE_PERFORM_OTA
        help
            HTTPS address of the update binary.

endmenu
```

## esp_wifi_remote/Kconfig
```kconfig
menu "Wi-Fi Remote"

    config ESP_WIFI_REMOTE_ENABLED
        bool
        default y

    config ESP_WIFI_REMOTE_STATIC_RX_BUFFER_NUM
        int "Max number of WiFi static RX buffers"
        range 0 128
        default 0

    config ESP_WIFI_REMOTE_DYNAMIC_RX_BUFFER_NUM
        int "Max number of WiFi dynamic RX buffers"
        range 0 1024
        default 0

    choice ESP_WIFI_REMOTE_TX_BUFFER
        prompt "Type of WiFi TX buffers"
        default ESP_WIFI_REMOTE_DYNAMIC_TX_BUFFER

        config ESP_WIFI_REMOTE_STATIC_TX_BUFFER
            bool "Static"

        config ESP_WIFI_REMOTE_DYNAMIC_TX_BUFFER
            bool "Dynamic"

    endchoice

    config ESP_WIFI_REMOTE_TX_BUFFER_TYPE
        int
        default 0 if ESP_WIFI_REMOTE_STATIC_TX_BUFFER
        default 1 if ESP_WIFI_REMOTE_DYNAMIC_TX_BUFFER

    config ESP_WIFI_REMOTE_STATIC_TX_BUFFER_NUM
        int "Max number of WiFi static TX buffers"
        depends on ESP_WIFI_REMOTE_STATIC_TX_BUFFER
        range 0 64
        default 0

    choice ESP_WIFI_REMOTE_MGMT_RX_BUFFER
        prompt "Type of WiFi RX MGMT buffers"
        default ESP_WIFI_REMOTE_STATIC_RX_MGMT_BUFFER

        config ESP_WIFI_REMOTE_STATIC_RX_MGMT_BUFFER
            bool "Static"
        config ESP_WIFI_REMOTE_DYNAMIC_RX_MGMT_BUFFER
            bool "Dynamic"
    endchoice

    config ESP_WIFI_REMOTE_DYNAMIC_RX_MGMT_BUF
        int
        default 0 if ESP_WIFI_REMOTE_STATIC_RX_MGMT_BUFFER
        default 1 if ESP_WIFI_REMOTE_DYNAMIC_RX_MGMT_BUFFER

    config ESP_WIFI_REMOTE_RX_MGMT_BUF_NUM_DEF
        int "Max number of WiFi RX MGMT buffers"
        range 0 10
        default 0

    config ESP_WIFI_REMOTE_CSI_ENABLED
        bool "WiFi CSI(Channel State Information)"
        depends on SOC_WIFI_REMOTE_CSI_SUPPORT
        default n

    config ESP_WIFI_REMOTE_AMPDU_TX_ENABLED
        bool "WiFi AMPDU TX"
        default y

    config ESP_WIFI_REMOTE_TX_BA_WIN
        int "WiFi AMPDU TX BA window size"
        depends on ESP_WIFI_REMOTE_AMPDU_TX_ENABLED
        range 0 64 if SOC_WIFI_REMOTE_HE_SUPPORT
        default 0

    config ESP_WIFI_REMOTE_AMPDU_RX_ENABLED
        bool "WiFi AMPDU RX"
        default y

    config ESP_REMOTE_WIFI_RX_BA_WIN
        int "WiFi AMPDU RX BA window size"
        depends on ESP_WIFI_REMOTE_AMPDU_RX_ENABLED
        range 0 64
        default 0

    config ESP_WIFI_REMOTE_ESPNOW_MAX_ENCRYPT_NUM
        int "Maximum espnow encrypt peers number"
        range 0 17
        default 0

    if !ESP_WIFI_ENABLED

        config ESP_WIFI_STATIC_RX_BUFFER_NUM
            int
            default ESP_WIFI_REMOTE_STATIC_RX_BUFFER_NUM

        config ESP_WIFI_DYNAMIC_RX_BUFFER_NUM
            int
            default ESP_WIFI_REMOTE_DYNAMIC_RX_BUFFER_NUM

        config ESP_WIFI_TX_BUFFER_TYPE
            int
            default ESP_WIFI_REMOTE_TX_BUFFER_TYPE

        config ESP_WIFI_STATIC_TX_BUFFER_NUM
            int
            depends on ESP_WIFI_REMOTE_STATIC_TX_BUFFER
            default ESP_WIFI_REMOTE_STATIC_TX_BUFFER_NUM

        config ESP_WIFI_DYNAMIC_RX_MGMT_BUF
            int
            default ESP_WIFI_REMOTE_DYNAMIC_RX_MGMT_BUF

        config ESP_WIFI_RX_MGMT_BUF_NUM_DEF
            int
            default ESP_WIFI_REMOTE_RX_MGMT_BUF_NUM_DEF

        config ESP_WIFI_CSI_ENABLED
            bool
            default ESP_WIFI_REMOTE_CSI_ENABLED

        config ESP_WIFI_AMPDU_TX_ENABLED
            bool
            default ESP_WIFI_REMOTE_AMPDU_TX_ENABLED

        config ESP_WIFI_TX_BA_WIN
            int
            default ESP_WIFI_REMOTE_TX_BA_WIN

        config ESP_WIFI_AMPDU_RX_ENABLED
            bool
            default ESP_WIFI_REMOTE_AMPDU_RX_ENABLED

        config ESP_WIFI_RX_BA_WIN
            int
            default ESP_REMOTE_WIFI_RX_BA_WIN

        config ESP_WIFI_ESPNOW_MAX_ENCRYPT_NUM
            int
            default ESP_WIFI_REMOTE_ESPNOW_MAX_ENCRYPT_NUM

    endif #!ESP_WIFI_ENABLED


endmenu # Wi-Fi remote
```

## examples/esp_netif/EthAp/main/Kconfig.projbuild
```kconfig
menu "Example Configuration"

    config EXAMPLE_ETH_AP_IP_ADDR
        string "Ethernet AP IP Address"
        default "192.168.5.1"
        help
            IP address for the Ethernet Access Point (DHCP server).
            This is the static IP address assigned to the Ethernet interface.

    config EXAMPLE_ETH_AP_NETMASK
        string "Ethernet AP Netmask"
        default "255.255.255.0"
        help
            Subnet mask for the Ethernet Access Point network.

    config EXAMPLE_ETH_AP_GW
        string "Ethernet AP Gateway"
        default "192.168.5.1"
        help
            Default gateway IP address for the Ethernet Access Point network.
            Typically set to the same IP as the AP itself.

    config EXAMPLE_ETH_AP_DHCP_LEASE_TIME
        int "DHCP Lease Time"
        default 120
        help
            DHCP lease time in units of LWIP_DHCPS_LEASE_UNIT (default 60 seconds).
            Example: Setting this to 120 means a 7200-second (2 hour) lease time.
            Setting this to 1 means a 60-second lease time.

    config EXAMPLE_ETH_AP_DHCP_START_ADDR
        string "DHCP IP Pool Start Address"
        default "192.168.5.2"
        help
            Starting IP address of the DHCP address pool.
            This is the first IP address that will be assigned to DHCP clients.

    config EXAMPLE_ETH_AP_DHCP_END_ADDR
        string "DHCP IP Pool End Address"
        default "192.168.5.100"
        help
            Ending IP address of the DHCP address pool.
            This is the last IP address that will be assigned to DHCP clients.
            Maximum pool size is 100 addresses (DHCPS_MAX_LEASE).

    config EXAMPLE_ETH_AP_DHCP_ENABLE_DNS
        bool "Enable DNS in DHCP Offers"
        default y
        help
            Enable DNS server information in DHCP offers.
            When enabled, DHCP clients will receive DNS server addresses.

    config EXAMPLE_ETH_AP_DHCP_DNS_MAIN
        string "Primary DNS Server"
        default "192.168.5.1"
        depends on EXAMPLE_ETH_AP_DHCP_ENABLE_DNS
        help
            Primary DNS server IP address to be provided to DHCP clients.
            Typically set to the AP IP address or a public DNS server.

    config EXAMPLE_ETH_AP_DHCP_DNS_BACKUP
        string "Backup DNS Server"
        default "8.8.8.8"
        depends on EXAMPLE_ETH_AP_DHCP_ENABLE_DNS
        help
            Backup DNS server IP address to be provided to DHCP clients.
            Typically set to a public DNS server like 8.8.8.8 (Google DNS).

endmenu
```
