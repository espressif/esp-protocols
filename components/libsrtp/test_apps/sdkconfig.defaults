## components/net_connect/Kconfig.projbuild
```kconfig
menu "Net Connect Configuration"

    config NET_CONNECT_WIFI
        bool "connect using WiFi interface"
        depends on !IDF_TARGET_LINUX && (SOC_WIFI_SUPPORTED || ESP_WIFI_REMOTE_ENABLED || ESP_HOST_WIFI_ENABLED)
        default y if SOC_WIFI_SUPPORTED
        help
            Protocol examples can use Wi-Fi, Ethernet and/or Thread to connect to the network.
            Choose this option to connect with WiFi

    if NET_CONNECT_WIFI
        config NET_CONNECT_WIFI_SSID_PWD_FROM_STDIN
            bool "Get ssid and password from stdin"
            default n
            help
                Give the WiFi SSID and password from stdin.

        config NET_CONNECT_PROVIDE_WIFI_CONSOLE_CMD
            depends on !NET_CONNECT_WIFI_SSID_PWD_FROM_STDIN
            bool "Provide wifi connect commands"
            default y
            help
                Provide wifi connect commands for esp_console.
                Please use `example_register_wifi_connect_commands` to register them.

        config NET_CONNECT_WIFI_SSID
            depends on !NET_CONNECT_WIFI_SSID_PWD_FROM_STDIN
            string "WiFi SSID"
            default "myssid"
            help
                SSID (network name) for the example to connect to.

        config NET_CONNECT_WIFI_PASSWORD
            depends on !NET_CONNECT_WIFI_SSID_PWD_FROM_STDIN
            string "WiFi Password"
            default "mypassword"
            help
                WiFi password (WPA or WPA2) for the example to use.
                Can be left blank if the network has no security set.

        config NET_CONNECT_WIFI_CONN_MAX_RETRY
            int "Maximum retry"
            default 6
            help
                Set the Maximum retry to avoid station reconnecting to the AP unlimited,
                in case the AP is really inexistent.

        choice NET_CONNECT_WIFI_SCAN_METHOD
            prompt "WiFi Scan Method"
            default NET_CONNECT_WIFI_SCAN_METHOD_ALL_CHANNEL
            help
                WiFi scan method:

                If "Fast" is selected, scan will end after find SSID match AP.

                If "All Channel" is selected, scan will end after scan all the channel.

            config NET_CONNECT_WIFI_SCAN_METHOD_FAST
                bool "Fast"
            config NET_CONNECT_WIFI_SCAN_METHOD_ALL_CHANNEL
                bool "All Channel"
        endchoice

        menu "WiFi Scan threshold"
            config NET_CONNECT_WIFI_SCAN_RSSI_THRESHOLD
                int "WiFi minimum rssi"
                range -127 0

                default -127
                help
                    The minimum rssi to accept in the scan mode.

            choice NET_CONNECT_WIFI_SCAN_AUTH_MODE_THRESHOLD
                prompt "WiFi Scan auth mode threshold"
                default NET_CONNECT_WIFI_AUTH_OPEN
                help
                    The weakest authmode to accept in the scan mode.

                config NET_CONNECT_WIFI_AUTH_OPEN
                    bool "OPEN"
                config NET_CONNECT_WIFI_AUTH_WEP
                    bool "WEP"
                config NET_CONNECT_WIFI_AUTH_WPA_PSK
                    bool "WPA PSK"
                config NET_CONNECT_WIFI_AUTH_WPA2_PSK
                    bool "WPA2 PSK"
                config NET_CONNECT_WIFI_AUTH_WPA_WPA2_PSK
                    bool "WPA WPA2 PSK"
                config NET_CONNECT_WIFI_AUTH_WPA2_ENTERPRISE
                    bool "WPA2 ENTERPRISE"
                config NET_CONNECT_WIFI_AUTH_WPA3_PSK
                    bool "WPA3 PSK"
                config NET_CONNECT_WIFI_AUTH_WPA2_WPA3_PSK
                    bool "WPA2 WPA3 PSK"
                config NET_CONNECT_WIFI_AUTH_WAPI_PSK
                    bool "WAPI PSK"
            endchoice
        endmenu

        choice NET_CONNECT_WIFI_CONNECT_AP_SORT_METHOD
            prompt "WiFi Connect AP Sort Method"
            default NET_CONNECT_WIFI_CONNECT_AP_BY_SIGNAL
            help
                WiFi connect AP sort method:

                If "Signal" is selected, Sort matched APs in scan list by RSSI.

                If "Security" is selected, Sort matched APs in scan list by security mode.

            config NET_CONNECT_WIFI_CONNECT_AP_BY_SIGNAL
                bool "Signal"
            config NET_CONNECT_WIFI_CONNECT_AP_BY_SECURITY
                bool "Security"
        endchoice
    endif

    config NET_CONNECT_ETHERNET
        bool "connect using Ethernet interface"
        depends on !IDF_TARGET_LINUX
        default y if !NET_CONNECT_WIFI && !NET_CONNECT_THREAD
        help
            Protocol examples can use Wi-Fi, Ethernet and/or Thread to connect to the network.
            Choose this option to enable connection with Ethernet.
            Go to `Top -> Ethernet Configuration` to configure the Ethernet interface.

    config NET_CONNECT_DISABLE_ETHERNET_CONFIG
        bool
        select ETHERNET_INIT_OVERRIDE_DISABLE
        default y if !NET_CONNECT_ETHERNET

    config NET_CONNECT_PPP
        bool "connect using Point to Point interface"
        select LWIP_PPP_SUPPORT
        help
            Protocol examples can use PPP connection over serial line.
            Choose this option to connect to the ppp server running
            on your laptop over a serial line (either UART or USB ACM)

    if NET_CONNECT_PPP
        choice NET_CONNECT_PPP_DEVICE
            prompt "Choose PPP device"
            default NET_CONNECT_PPP_DEVICE_USB
            help
                Select which peripheral to use to connect to the PPP server.

            config NET_CONNECT_PPP_DEVICE_USB
                bool "USB"
                depends on SOC_USB_OTG_SUPPORTED
                select TINYUSB_CDC_ENABLED
                help
                    Use USB ACM device.

            config NET_CONNECT_PPP_DEVICE_UART
                bool "UART"
                help
                    Use UART.

        endchoice

        menu "UART Configuration"
            depends on NET_CONNECT_PPP_DEVICE_UART
            config NET_CONNECT_UART_TX_PIN
                int "TXD Pin Number"
                default 4
                range 0 31
                help
                    Pin number of UART TX.

            config NET_CONNECT_UART_RX_PIN
                int "RXD Pin Number"
                default 5
                range 0 31
                help
                    Pin number of UART RX.

            config NET_CONNECT_UART_BAUDRATE
                int "UART Baudrate"
                default 115200
                range 9600 3000000
                help
                    Baudrate of the UART device

        endmenu

        config NET_CONNECT_PPP_CONN_MAX_RETRY
            int "Maximum retry"
            default 6
            help
                Set the Maximum retry to avoid station reconnecting if the pppd
                is not available

    endif # NET_CONNECT_PPP

    config NET_CONNECT_THREAD
        bool "Connect using Thread interface"
        depends on !IDF_TARGET_LINUX && OPENTHREAD_ENABLED
        default y if SOC_IEEE802154_SUPPORTED
        select NET_CONNECT_IPV6
        help
            Protocol examples can use Wi-Fi, Ethernet and/or Thread to connect to the network.
            Choose this option to connect with Thread.
            The operational active dataset of the Thread network can be configured in openthread
            component at '->Components->OpenThread->Thread Core Features->Thread Operational Dataset'

    if NET_CONNECT_THREAD
        config NET_CONNECT_THREAD_TASK_STACK_SIZE
            int "Example Thread task stack size"
            default 8192
            help
                Thread task stack size

        menu "Radio Spinel Options"
            depends on OPENTHREAD_RADIO_SPINEL_UART || OPENTHREAD_RADIO_SPINEL_SPI

            config NET_CONNECT_THREAD_UART_RX_PIN
                depends on OPENTHREAD_RADIO_SPINEL_UART
                int "Uart Rx Pin"
                default 17

            config NET_CONNECT_THREAD_UART_TX_PIN
                depends on OPENTHREAD_RADIO_SPINEL_UART
                int "Uart Tx pin"
                default 18

            config NET_CONNECT_THREAD_UART_BAUD
                depends on OPENTHREAD_RADIO_SPINEL_UART
                int "Uart baud rate"
                default 460800

            config NET_CONNECT_THREAD_UART_PORT
                depends on OPENTHREAD_RADIO_SPINEL_UART
                int "Uart port"
                default 1

            config NET_CONNECT_THREAD_SPI_CS_PIN
                depends on OPENTHREAD_RADIO_SPINEL_SPI
                int "SPI CS Pin"
                default 10

            config NET_CONNECT_THREAD_SPI_SCLK_PIN
                depends on OPENTHREAD_RADIO_SPINEL_SPI
                int "SPI SCLK Pin"
                default 12

            config NET_CONNECT_THREAD_SPI_MISO_PIN
                depends on OPENTHREAD_RADIO_SPINEL_SPI
                int "SPI MISO Pin"
                default 13

            config NET_CONNECT_THREAD_SPI_MOSI_PIN
                depends on OPENTHREAD_RADIO_SPINEL_SPI
                int "SPI MOSI Pin"
                default 11

            config NET_CONNECT_THREAD_SPI_INTR_PIN
                depends on OPENTHREAD_RADIO_SPINEL_SPI
                int "SPI Interrupt Pin"
                default 8
        endmenu

    endif

    config NET_CONNECT_IPV4
        bool
        depends on LWIP_IPV4
        default n if NET_CONNECT_THREAD
        default y

    config NET_CONNECT_IPV6
        depends on NET_CONNECT_WIFI || NET_CONNECT_ETHERNET || NET_CONNECT_PPP || NET_CONNECT_THREAD
        bool "Obtain IPv6 address"
        default y
        select LWIP_IPV6
        select LWIP_PPP_ENABLE_IPV6 if NET_CONNECT_PPP
        help
            By default, examples will wait until IPv4 and IPv6 local link addresses are obtained.
            Disable this option if the network does not support IPv6.
            Choose the preferred IPv6 address type if the connection code should wait until other than
            the local link address gets assigned.
            Consider enabling IPv6 stateless address autoconfiguration (SLAAC) in the LWIP component.

    if NET_CONNECT_IPV6
        choice NET_CONNECT_PREFERRED_IPV6
            prompt "Preferred IPv6 Type"
            default NET_CONNECT_IPV6_PREF_LOCAL_LINK
            help
                Select which kind of IPv6 address the connect logic waits for.

            config NET_CONNECT_IPV6_PREF_LOCAL_LINK
                bool "Local Link Address"
                help
                    Blocks until Local link address assigned.

            config NET_CONNECT_IPV6_PREF_GLOBAL
                bool "Global Address"
                help
                    Blocks until Global address assigned.

            config NET_CONNECT_IPV6_PREF_SITE_LOCAL
                bool "Site Local Address"
                help
                    Blocks until Site link address assigned.

            config NET_CONNECT_IPV6_PREF_UNIQUE_LOCAL
                bool "Unique Local Link Address"
                help
                    Blocks until Unique local address assigned.

        endchoice

    endif


endmenu
```

## components/net_connect/examples/ppp_connect_example/sdkconfig.defaults
```kconfig
# PPP Connection Example Configuration
# Enable PPP connection
CONFIG_NET_CONNECT_PPP=y

# Disable other interfaces to focus on PPP
CONFIG_NET_CONNECT_WIFI=n
CONFIG_NET_CONNECT_ETHERNET=n
CONFIG_NET_CONNECT_THREAD=n

# Enable IPv6 support
CONFIG_NET_CONNECT_IPV6=y

# PPP device selection
# For ESP32-S3, S2, P4, H4 and other boards with USB OTG support:
#   - Enable USB CDC (uncomment line below)
#   - Ensure esp_tinyusb dependency is uncommented in idf_component.yml
CONFIG_NET_CONNECT_PPP_DEVICE_USB=y
#
# For UART mode (ESP32, C3, C6, etc. without USB OTG, requires USB-to-Serial adapter):
#   - Enable UART (uncomment line below)
#   - Comment out esp_tinyusb dependency in idf_component.yml
# CONFIG_NET_CONNECT_PPP_DEVICE_UART=y

# UART configuration (only used if CONFIG_NET_CONNECT_PPP_DEVICE_UART=y)
CONFIG_NET_CONNECT_UART_TX_PIN=4
CONFIG_NET_CONNECT_UART_RX_PIN=5
CONFIG_NET_CONNECT_UART_BAUDRATE=115200

# PPP connection retry configuration
CONFIG_NET_CONNECT_PPP_CONN_MAX_RETRY=6
```

## components/usrsctp/Kconfig
```kconfig
menu "usrsctp"

    config USRSCTP_DEBUG
        bool "Enable SCTP_DEBUG runtime tracing"
        default n
        help
            Builds usrsctp with verbose runtime trace logging via SCTP_DEBUG.
            Adds binary size; only useful during development.

    config USRSCTP_THREAD_STACK_IN_SPIRAM
        bool "Allocate usrsctp's internal pthread stacks from SPIRAM"
        depends on SPIRAM
        default y
        help
            Routes usrsctp's userspace-mode worker threads to SPIRAM.
            Strongly recommended on memory-constrained chips
            (esp32c6, esp32p4-eye) where internal RAM is at a premium.

    config USRSCTP_USE_MBEDTLS_SHA1
        bool "Use mbedTLS for SHA1 instead of usrsctp's bundled implementation"
        default y
        help
            Uses ESP-IDF's mbedTLS (typically backed by the on-chip SHA
            peripheral) for SHA-1 hashing inside usrsctp. Smaller binary
            and faster than usrsctp's bundled software SHA-1.

endmenu
```

## esp_modem/Kconfig
```kconfig
menu "ESP-MODEM"

    config MODEM_LEGACY_API
        bool "Enable Legacy API"
        default y
        help
            Set to true if the original pppos_client API from the example's internal
            component should be used.....

    config MODEM_PPP_APN
        string "Local netif hostname"
        default 'internet'
        depends on MODEM_LEGACY_API
        help
            APN (Access Point Name), a logical name of a network
            the modem connects to in the PPP mode

endmenu
```

## esp_modem/examples/ap_to_pppos/sdkconfig.defaults
```kconfig
CONFIG_LWIP_PPP_SUPPORT=y
CONFIG_LWIP_PPP_PAP_SUPPORT=y
CONFIG_LWIP_TCPIP_TASK_STACK_SIZE=4096
CONFIG_LWIP_PPP_ENABLE_IPV6=n
CONFIG_UART_ISR_IN_IRAM=y
# Enable NAPT
CONFIG_LWIP_IP_FORWARD=y
CONFIG_LWIP_IPV4_NAPT=y
```
