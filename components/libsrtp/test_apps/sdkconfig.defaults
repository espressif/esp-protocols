## components/libsrtp/test_apps/sdkconfig.defaults
```kconfig
# Speed up CI run + small binary
CONFIG_COMPILER_OPTIMIZATION_SIZE=y
CONFIG_FREERTOS_UNICORE=y
```

## components/libwebsockets/Kconfig
```kconfig
menu "libwebsockets"

    # All defaults below preserve the previously-baked behaviour
    # (extensions off, file_ops on, threadpool off). Flip them to suit
    # the workload — e.g. WebRTC signaling consumers enable extensions
    # for permessage-deflate and threadpool for parallel TLS work.

    config LWS_WITH_EXTENSIONS
        bool "Build libwebsockets with extensions (permessage-deflate, mux)"
        default n
        help
            Enables LWS extensions support. Required for clients/servers
            that negotiate permessage-deflate or other RFC 7692 extensions
            over the WebSocket handshake. Requires LWS_WITH_ZLIB at link
            time, which the ESP-IDF mbedTLS build does not pull in by
            default — you'll need to add zlib as a dependency.

    config LWS_WITH_FILE_OPS
        bool "Build libwebsockets with the file-operations VFS"
        default y
        help
            Compiles the libwebsockets virtual filesystem layer used by
            server-side static file serving. Disable on embedded targets
            that don't expose a real filesystem to lws to save flash.

    config LWS_WITH_THREADPOOL
        bool "Build libwebsockets with the worker threadpool API"
        default n
        help
            Enables lws's managed worker thread pool (pthread-backed).
            Used by clients that want to off-load parallel TLS handshake
            or other work from the lws service thread (e.g. AWS KVS
            WebRTC signaling). Costs a few hundred bytes of static data.

    config LWS_WITH_CUSTOM_HEADERS
        bool "Build libwebsockets with custom HTTP header support"
        default n
        help
            Enables the lws_hdr_custom_* APIs for reading non-standard
            HTTP headers (sets LWS_WITH_CUSTOM_HEADERS and
            LWS_WITH_CUSTOM_HTTP_HEADERS). Required by clients that must
            read service-specific response headers — e.g. AWS KVS WebRTC
            signaling reads the x-amzn-RequestId header over HTTP/1.1.

endmenu
```

## components/libwebsockets/examples/client/sdkconfig.defaults
```kconfig
# The libwebsockets client (mbedTLS + TLS) exceeds the 1 MB default single-app
# partition. Use the large single-app layout so a plain `idf.py build` fits.
CONFIG_PARTITION_TABLE_SINGLE_APP_LARGE=y
```

## components/libwebsockets/examples/server-echo/main/Kconfig.projbuild
```kconfig
menu "Example Configuration"
    config WEBSOCKET_PORT
        int "Websocket endpoint PORT"
        default 80
        help
            Port of websocket endpoint this example connects to and sends echo
    config WS_OVER_TLS
        bool "Enable WebSocket over TLS with Server Certificate"
        default y
        help
            Enables WebSocket connections over TLS (WSS)
endmenu
```

## components/mbedtls_cxx/tests/uart_mutual_auth/main/Kconfig.projbuild
```kconfig
menu "Test Configuration"

    choice TEST_CONNECTION_METHOD
        prompt "Choose connection method"
        default TEST_TLS
        help
            Select type of connection. Either TLS or DTLS

        config TEST_TLS
            bool "TLS"
            help
                Use TLS method.
        config TEST_DTLS
            bool "DTLS"
            help
                Use DTLS method.
    endchoice # TEST_CONNECTION_METHOD

endmenu
```

## components/mbedtls_cxx/tests/uart_mutual_auth/sdkconfig.defaults
```kconfig
CONFIG_IDF_TARGET="esp32"
CONFIG_MBEDTLS_SSL_PROTO_DTLS=y
CONFIG_MBEDTLS_SSL_COOKIE_C=y
CONFIG_PTHREAD_TASK_STACK_SIZE_DEFAULT=8192
```

## components/mdns/tests/host_test/sdkconfig.defaults
```kconfig
CONFIG_IDF_TARGET="linux"
CONFIG_MDNS_NETWORKING_SOCKET=y
CONFIG_MDNS_SKIP_SUPPRESSING_OWN_QUERIES=y
CONFIG_TEST_NETIF_NAME="eth0"
CONFIG_TEST_HOSTNAME="myesp"
# CONFIG_MDNS_PREDEF_NETIF_STA is not set
# CONFIG_MDNS_PREDEF_NETIF_AP is not set
```

## components/mosq/examples/broker/main/Kconfig.projbuild
```kconfig
menu "Example Configuration"

    config EXAMPLE_BROKER_USE_CONNECTED_NETIF
        bool "Bind the broker to the connected interface"
        default y
        help
            Disable this if you want to use any other network interface
            for the broker to listen to.

    config EXAMPLE_BROKER_HOST
        string "Broker host address"
        depends on !EXAMPLE_BROKER_USE_CONNECTED_NETIF
        default "127.0.0.1"
        help
            Host name of the endpoint to bind the mosquitto listener.

    config EXAMPLE_BROKER_PORT
        int "Broker port"
        default 1883
        help
            Port of the endpoint to bind the mosquitto listener

    config EXAMPLE_BROKER_RUN_LOCAL_MQTT_CLIENT
        bool "Run a local mqtt client"
        default y
        help
            If enabled, it runs a local mqtt client connecting
            to the same endpoint ans the broker listens to

endmenu
```

## components/mosquitto/Kconfig
```kconfig
menu "Mosquitto"

    config MOSQ_IS_ENABLED
        # Invisible option that is enabled if MOSQ is added to the IDF components.
        # This is used to "select" CONFIG_ESP_TLS_SERVER option (needed for TLS connection)
        # (these are optionally used in mosq)
        bool
        default "y"
        select ESP_TLS_SERVER

    config MOSQ_ENABLE_SYS
        bool "Enable $SYS topics"
        default n
        help
            Enable the $SYS topics for the broker

    config MOSQ_SYS_UPDATE_INTERVAL
        int "Update interval for the SYS topic"
        default 10
        depends on MOSQ_ENABLE_SYS
        help
            Time in seconds for the update of the $SYS topics for the broker
endmenu
```

## components/mosquitto/examples/broker/main/Kconfig.projbuild
```kconfig
menu "Example Configuration"

    config EXAMPLE_BROKER_HOST
        string "Broker host address"
        default "0.0.0.0"
        help
            Host name of the endpoint to bind the mosquitto listener.

    config EXAMPLE_BROKER_PORT
        int "Broker port"
        default 1883
        help
            Port of the endpoint to bind the mosquitto listener

    config EXAMPLE_BROKER_RUN_LOCAL_MQTT_CLIENT
        bool "Run a local mqtt client"
        default y
        help
            If enabled, it runs a local mqtt client connecting
            to the same endpoint ans the broker listens to

    config EXAMPLE_BROKER_USE_BASIC_AUTH
        bool "Use basic authentication (username/password)"
        default n
        help
            If enabled, the broker will require username and password
            authentication. The example uses "testuser" / "testpass" as
            credentials. The client will also use these credentials when
            connecting to the broker.

    config EXAMPLE_BROKER_WITH_TLS
        bool "Use TLS"
        default y
        help
            If enabled, the broker (and the client too, if enabled)
            uses TLS transport layer

endmenu
```

## components/mosquitto/examples/serverless_mqtt/main/Kconfig.projbuild
```kconfig
menu "Example Configuration"

    menu "AP Configuration"
        comment "AP Configuration"

        config EXAMPLE_AP_SSID
            string "Wi-Fi SSID"
            default "myssid"
            help
                Set the SSID of Wi-Fi ap interface.

        config EXAMPLE_AP_PASSWORD
            string "Wi-Fi Password"
            default "12345678"
            help
                Set the password of Wi-Fi ap interface.

    endmenu

    menu "STA Configuration"
        comment "STA Configuration"

        config EXAMPLE_STA_SSID
            string "WiFi Station SSID"
            default "mystationssid"
            help
                SSID for the example's sta to connect to.

        config EXAMPLE_STA_PASSWORD
            string "WiFi Station Password"
            default "mystationpassword"
            help
                WiFi station password for the example to use.
    endmenu

    config EXAMPLE_MQTT_BROKER_URI
        string "MQTT Broker URL"
        default "mqtt://mqtt.eclipseprojects.io"
        help
            URL of the mqtt broker use for synchronisation and exchanging
            ICE connect info (description and candidates).

    config EXAMPLE_MQTT_SYNC_TOPIC
        string "MQTT topic for synchronisation"
        default "/topic/serverless_mqtt"
        help
            MQTT topic used fo synchronisation.

    config EXAMPLE_STUN_SERVER
        string "Hostname of STUN server"
        default "stun.l.google.com"
        help
            STUN server hostname.

    config EXAMPLE_MQTT_CLIENT_STACK_SIZE
        int "Stack size for mqtt client"
        default 16384
        help
            Set stack size for the mqtt client.
            Need more stack, since calling juice API from the handler.

    config EXAMPLE_MQTT_BROKER_PORT
        int "port for the mosquitto to listen to"
        default 1883
        help
            This is a port which the local mosquitto uses.

    choice EXAMPLE_SERVERLESS_ROLE
        prompt "Choose your role"
        default EXAMPLE_SERVERLESS_ROLE_PEER1
        help
            Choose either peer1 or peer2.
            It's not very important which device is peer1
            (peer-1 sends sync messages, peer2 listens for them)
            It is important that we have two peers,
            one with peer1 config, another one with peer2 config

        config EXAMPLE_SERVERLESS_ROLE_PEER1
            bool "peer1"

        config EXAMPLE_SERVERLESS_ROLE_PEER2
            bool "peer2"
    endchoice

endmenu
```

## components/mosquitto/examples/serverless_mqtt/sdkconfig.defaults
```kconfig
CONFIG_PARTITION_TABLE_SINGLE_APP_LARGE=y
CONFIG_ESP_MAIN_TASK_STACK_SIZE=16384
CONFIG_PTHREAD_TASK_STACK_SIZE_DEFAULT=32768
CONFIG_LWIP_SNTP_MAX_SERVERS=2
CONFIG_MBEDTLS_SSL_PROTO_DTLS=y
CONFIG_MBEDTLS_SSL_DTLS_SRTP=y
```
