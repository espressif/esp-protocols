## examples/esp_netif/multiple_netifs/main/Kconfig.projbuild
```kconfig
menu "Example Configuration"

    config ESP_WIFI_SSID
        string "WiFi SSID"
        default "myssid"
        help
            SSID (network name) for the example to connect to.

    config ESP_WIFI_PASSWORD
        string "WiFi Password"
        default "mypassword"
        help
            WiFi password (WPA or WPA2) for the example to use.

    config ESP_MAXIMUM_RETRY
        int "Maximum retry"
        default 0
        help
            Set the Maximum retry to avoid station reconnecting. Set to 0 to keep retrying indefinitely.

    config EXAMPLE_MODEM_PPP_APN
        string "Set MODEM APN"
        default "default.apn"
        help
            Set APN (Access Point Name), a logical name to choose data network

    config EXAMPLE_PPP_UART_TX_PIN
        int "TXD Pin Number"
        default 15
        range 0 31
        help
            Pin number of UART TX.

    config EXAMPLE_PPP_UART_RX_PIN
        int "RXD Pin Number"
        default 14
        range 0 31
        help
            Pin number of UART RX.

    choice EXAMPLE_PPP_CONNECT
        prompt "Connect to PPP server"
        default EXAMPLE_PPP_CONNECT_ESP_MODEM
        help
            Choose modem interface library.
            We use esp_modem by default, but in some
            simple cases (and a very constrained environment)
            we could simply connect UART directly to lwIP.
            To experiment with this option, choose EXAMPLE_PPP_CONNECT_SIMPLE

        config EXAMPLE_PPP_CONNECT_ESP_MODEM
            bool "Using esp_modem library"
        config EXAMPLE_PPP_CONNECT_SIMPLE
            bool "Using simple UART-PPP driver"
    endchoice

    config EXAMPLE_DEMONSTRATE_DNS_CLEAR_CACHE
        bool "Run DNS clear cache"
        default n
        help
            This example will cleanup the DNS cache
            every iteration of the demo network operation.
            This forces the TCP/IP stack to always resolve DNS names,
            thus exercising potentially invalid DNS configuration.
            Set this to "y" for testing, but keep as "n" for production.

endmenu
```

## examples/esp_netif/multiple_netifs/sdkconfig.defaults
```kconfig
# You can use CONFIG_ESP_NETIF_SET_DNS_PER_DEFAULT_NETIF
# to perform DNS server updates automatically in esp_netif layers
# instead of manually as it is demonstrated in this example
CONFIG_LWIP_PPP_SUPPORT=y
CONFIG_LWIP_PPP_NOTIFY_PHASE_SUPPORT=y
```

## examples/esp_netif/slip_custom_netif/sdkconfig.defaults
```kconfig
# Override some defaults to enable SLIP
CONFIG_LWIP_SLIP_SUPPORT=y
# Workaround: Enable PPP to let esp_netif know that lwip's netif->state
#             will be occupied (by SLIP netif info)
CONFIG_LWIP_PPP_SUPPORT=y
```

## examples/mqtt/main/Kconfig.projbuild
```kconfig
menu "Example Configuration"

    config BROKER_URL
        string "Broker URL"
        default "mqtt://test.mosquitto.org"
        help
            URL of the broker to connect to

endmenu
```

## examples/websocket_features/main/Kconfig.projbuild
```kconfig
menu "WebSocket Feature Showcase Configuration"

config WEBSOCKET_FEATURES_URI
    string "WebSocket endpoint URI"
    default "wss://echo.websocket.events"
    help
        URI used by the websocket_features example.

endmenu
```

## test_app/sdkconfig.defaults
```kconfig
CONFIG_ESP_INT_WDT=n
CONFIG_ESP_TASK_WDT=n
CONFIG_ESPTOOLPY_FLASHSIZE_4MB=y
CONFIG_PARTITION_TABLE_CUSTOM=y
CONFIG_PARTITION_TABLE_CUSTOM_FILENAME="partitions.csv"
CONFIG_PARTITION_TABLE_FILENAME="partitions.csv"

# Run-time checks of Heap and Stack
CONFIG_HEAP_POISONING_COMPREHENSIVE=y
CONFIG_COMPILER_STACK_CHECK_MODE_STRONG=y
CONFIG_COMPILER_STACK_CHECK=y
CONFIG_ESP_MAIN_TASK_STACK_SIZE=16000
CONFIG_FREERTOS_WATCHPOINT_END_OF_STACK=y

CONFIG_UNITY_ENABLE_BACKTRACE_ON_FAIL=y
```
