## examples/esp_netif/EthApWifiAp/main/Kconfig.projbuild
```kconfig
menu "Example Configuration"

    # Ethernet AP Configuration
    config EXAMPLE_ETH_AP_IP_ADDR
        string "Ethernet AP IP Address"
        default "192.168.5.1"
        help
            IP address for the Ethernet Access Point (DHCP server).
            This is the static IP address assigned to the Ethernet interface.

    config EXAMPLE_ETH_AP_NETMASK
        string "Ethernet AP Netmask"
        default "255.255.255.0"
        help
            Subnet mask for the Ethernet Access Point network.

    config EXAMPLE_ETH_AP_GW
        string "Ethernet AP Gateway"
        default "192.168.5.1"
        help
            Default gateway IP address for the Ethernet Access Point network.
            Typically set to the same IP as the AP itself.

    config EXAMPLE_ETH_AP_DHCP_LEASE_TIME
        int "Ethernet AP DHCP Lease Time"
        default 120
        help
            DHCP lease time in units of LWIP_DHCPS_LEASE_UNIT (default 60 seconds).
            Example: Setting this to 120 means a 7200-second (2 hour) lease time.
            Setting this to 1 means a 60-second lease time.

    config EXAMPLE_ETH_AP_DHCP_START_ADDR
        string "Ethernet AP DHCP IP Pool Start Address"
        default "192.168.5.2"
        help
            Starting IP address of the DHCP address pool.
            This is the first IP address that will be assigned to DHCP clients.

    config EXAMPLE_ETH_AP_DHCP_END_ADDR
        string "Ethernet AP DHCP IP Pool End Address"
        default "192.168.5.100"
        help
            Ending IP address of the DHCP address pool.
            This is the last IP address that will be assigned to DHCP clients.
            Maximum pool size is 100 addresses (DHCPS_MAX_LEASE).

    config EXAMPLE_ETH_AP_DHCP_ENABLE_DNS
        bool "Enable DNS in Ethernet AP DHCP Offers"
        default y
        help
            Enable DNS server information in DHCP offers.
            When enabled, DHCP clients will receive DNS server addresses.

    config EXAMPLE_ETH_AP_DHCP_DNS_MAIN
        string "Ethernet AP Primary DNS Server"
        default "192.168.5.1"
        depends on EXAMPLE_ETH_AP_DHCP_ENABLE_DNS
        help
            Primary DNS server IP address to be provided to DHCP clients.
            Typically set to the AP IP address or a public DNS server.

    config EXAMPLE_ETH_AP_DHCP_DNS_BACKUP
        string "Ethernet AP Backup DNS Server"
        default "8.8.8.8"
        depends on EXAMPLE_ETH_AP_DHCP_ENABLE_DNS
        help
            Backup DNS server IP address to be provided to DHCP clients.
            Typically set to a public DNS server like 8.8.8.8 (Google DNS).

    # WiFi AP Configuration
    config EXAMPLE_WIFI_AP_SSID
        string "WiFi AP SSID"
        default "myssid-ext"
        help
            SSID (network name) for the WiFi Access Point.

    config EXAMPLE_WIFI_AP_PASS
        string "WiFi AP Password"
        default "mypassword"
        help
            WiFi password (WPA or WPA2) for the Access Point.

    config EXAMPLE_WIFI_AP_CHANNEL
        int "WiFi AP Channel"
        range 1 13
        default 1
        help
            WiFi channel for the Access Point (1-13).

    config EXAMPLE_WIFI_AP_IP_ADDR
        string "WiFi AP IP Address"
        default "192.168.4.1"
        help
            IP address for the WiFi Access Point (DHCP server).
            This is the static IP address assigned to the WiFi AP interface.

    config EXAMPLE_WIFI_AP_NETMASK
        string "WiFi AP Netmask"
        default "255.255.255.0"
        help
            Subnet mask for the WiFi Access Point network.

    config EXAMPLE_WIFI_AP_GW
        string "WiFi AP Gateway"
        default "192.168.4.1"
        help
            Default gateway IP address for the WiFi Access Point network.
            Typically set to the same IP as the AP itself.

    config EXAMPLE_WIFI_AP_DHCP_LEASE_TIME
        int "WiFi AP DHCP Lease Time"
        default 120
        help
            DHCP lease time in units of LWIP_DHCPS_LEASE_UNIT (default 60 seconds).
            Example: Setting this to 120 means a 7200-second (2 hour) lease time.
            Setting this to 1 means a 60-second lease time.

    config EXAMPLE_WIFI_AP_DHCP_START_ADDR
        string "WiFi AP DHCP IP Pool Start Address"
        default "192.168.4.2"
        help
            Starting IP address of the DHCP address pool.
            This is the first IP address that will be assigned to DHCP clients.

    config EXAMPLE_WIFI_AP_DHCP_END_ADDR
        string "WiFi AP DHCP IP Pool End Address"
        default "192.168.4.100"
        help
            Ending IP address of the DHCP address pool.
            This is the last IP address that will be assigned to DHCP clients.
            Maximum pool size is 100 addresses (DHCPS_MAX_LEASE).

    config EXAMPLE_WIFI_AP_DHCP_ENABLE_DNS
        bool "Enable DNS in WiFi AP DHCP Offers"
        default y
        help
            Enable DNS server information in DHCP offers.
            When enabled, DHCP clients will receive DNS server addresses.

    config EXAMPLE_WIFI_AP_DHCP_DNS_MAIN
        string "WiFi AP Primary DNS Server"
        default "192.168.4.1"
        depends on EXAMPLE_WIFI_AP_DHCP_ENABLE_DNS
        help
            Primary DNS server IP address to be provided to DHCP clients.
            Typically set to the AP IP address or a public DNS server.

    config EXAMPLE_WIFI_AP_DHCP_DNS_BACKUP
        string "WiFi AP Backup DNS Server"
        default "8.8.8.8"
        depends on EXAMPLE_WIFI_AP_DHCP_ENABLE_DNS
        help
            Backup DNS server IP address to be provided to DHCP clients.
            Typically set to a public DNS server like 8.8.8.8 (Google DNS).

endmenu
```

## examples/esp_netif/EthStaWifiSta/main/Kconfig.projbuild
```kconfig
menu "Example Configuration"

    config EXAMPLE_ESP_WIFI_SSID
        string "WiFi SSID"
        default "myssid"
        help
            SSID (network name) for the example to connect to.

    config EXAMPLE_ESP_WIFI_PASS
        string "WiFi Password"
        default "mypassword"
        help
            WiFi password (WPA or WPA2) for the example to use.

endmenu
```

## examples/esp_netif/WifiApWifiSta/main/Kconfig.projbuild
```kconfig
menu "Example Configuration"

    # WiFi AP Configuration
    config EXAMPLE_WIFI_AP_SSID
        string "WiFi AP SSID"
        default "myssid-ext"
        help
            SSID (network name) for the WiFi Access Point.

    config EXAMPLE_WIFI_AP_PASS
        string "WiFi AP Password"
        default "mypassword"
        help
            WiFi password (WPA or WPA2) for the Access Point.

    config EXAMPLE_WIFI_AP_CHANNEL
        int "WiFi AP Channel"
        range 1 13
        default 1
        help
            WiFi channel for the Access Point (1-13).

    config EXAMPLE_WIFI_AP_IP_ADDR
        string "WiFi AP IP Address"
        default "192.168.5.1"
        help
            IP address for the WiFi Access Point (DHCP server).
            This is the static IP address assigned to the WiFi AP interface.

    config EXAMPLE_WIFI_AP_NETMASK
        string "WiFi AP Netmask"
        default "255.255.255.0"
        help
            Subnet mask for the WiFi Access Point network.

    config EXAMPLE_WIFI_AP_GW
        string "WiFi AP Gateway"
        default "192.168.5.1"
        help
            Default gateway IP address for the WiFi Access Point network.
            Typically set to the same IP as the AP itself.

    config EXAMPLE_WIFI_AP_DHCP_LEASE_TIME
        int "DHCP Lease Time"
        default 120
        help
            DHCP lease time in units of LWIP_DHCPS_LEASE_UNIT (default 60 seconds).
            Example: Setting this to 120 means a 7200-second (2 hour) lease time.
            Setting this to 1 means a 60-second lease time.

    config EXAMPLE_WIFI_AP_DHCP_START_ADDR
        string "DHCP IP Pool Start Address"
        default "192.168.5.2"
        help
            Starting IP address of the DHCP address pool.
            This is the first IP address that will be assigned to DHCP clients.

    config EXAMPLE_WIFI_AP_DHCP_END_ADDR
        string "DHCP IP Pool End Address"
        default "192.168.5.100"
        help
            Ending IP address of the DHCP address pool.
            This is the last IP address that will be assigned to DHCP clients.
            Maximum pool size is 100 addresses (DHCPS_MAX_LEASE).

    config EXAMPLE_WIFI_AP_DHCP_ENABLE_DNS
        bool "Enable DNS in DHCP Offers"
        default y
        help
            Enable DNS server information in DHCP offers.
            When enabled, DHCP clients will receive DNS server addresses.
            If enabled, DNS can be configured to use WiFi STA's DNS servers.

    config EXAMPLE_WIFI_AP_DHCP_DNS_MAIN
        string "Primary DNS Server"
        default "192.168.5.1"
        depends on EXAMPLE_WIFI_AP_DHCP_ENABLE_DNS
        help
            Primary DNS server IP address to be provided to DHCP clients.
            Typically set to the AP IP address or a public DNS server.
            Can be overridden to use WiFi STA's DNS if available.

    config EXAMPLE_WIFI_AP_DHCP_DNS_BACKUP
        string "Backup DNS Server"
        default "8.8.8.8"
        depends on EXAMPLE_WIFI_AP_DHCP_ENABLE_DNS
        help
            Backup DNS server IP address to be provided to DHCP clients.
            Typically set to a public DNS server like 8.8.8.8 (Google DNS).

    # WiFi STA Configuration
    config EXAMPLE_WIFI_STA_SSID
        string "WiFi STA SSID"
        default "myssid"
        help
            SSID (network name) for the example to connect to.

    config EXAMPLE_WIFI_STA_PASS
        string "WiFi STA Password"
        default "mypassword"
        help
            WiFi password (WPA or WPA2) for the example to use.

endmenu
```

## examples/esp_netif/cslip_custom_netif/sdkconfig.defaults
```kconfig
# Enable SLIP in lwIP (CSLIP currently pass-through)
CONFIG_LWIP_SLIP_SUPPORT=y
# Workaround: Enable PPP so esp_netif accounts for lwIP netif->state usage
CONFIG_LWIP_PPP_SUPPORT=y
```

## examples/esp_netif/eth_endpoint_wifi_sta/main/Kconfig.projbuild
```kconfig
menu "Example Configuration"

    config EXAMPLE_ESP_WIFI_SSID
        string "WiFi SSID"
        default "myssid"
        help
            SSID (network name) for the example to connect to.

    config EXAMPLE_ESP_WIFI_PASS
        string "WiFi Password"
        default "mypassword"
        help
            WiFi password (WPA or WPA2) for the example to use.

    choice EXAMPLE_ESP_WIFI_STA_AUTHMODE_THRESHOLD
        prompt "WiFi STA scan authentication threshold"
        default EXAMPLE_ESP_WIFI_STA_AUTHMODE_THRESHOLD_WPA2_PSK
        help
            Minimum authentication mode accepted when scanning and connecting as a station.
            Lower this to connect to older networks (WEP/WPA).

        config EXAMPLE_ESP_WIFI_STA_AUTHMODE_THRESHOLD_OPEN
            bool "Open"
        config EXAMPLE_ESP_WIFI_STA_AUTHMODE_THRESHOLD_WEP
            bool "WEP"
        config EXAMPLE_ESP_WIFI_STA_AUTHMODE_THRESHOLD_WPA_PSK
            bool "WPA PSK"
        config EXAMPLE_ESP_WIFI_STA_AUTHMODE_THRESHOLD_WPA2_PSK
            bool "WPA2 PSK"
        config EXAMPLE_ESP_WIFI_STA_AUTHMODE_THRESHOLD_WPA_WPA2_PSK
            bool "WPA/WPA2 PSK"
        config EXAMPLE_ESP_WIFI_STA_AUTHMODE_THRESHOLD_WPA3_PSK
            bool "WPA3 PSK"
    endchoice

endmenu
```

## examples/esp_netif/eth_gateway_wifi_sta/main/Kconfig.projbuild
```kconfig
menu "Example Configuration"

    config EXAMPLE_ESP_WIFI_SSID
        string "WiFi SSID"
        default "myssid"
        help
            SSID (network name) for the example to connect to.

    config EXAMPLE_ESP_WIFI_PASS
        string "WiFi Password"
        default "mypassword"
        help
            WiFi password (WPA or WPA2) for the example to use.

    choice EXAMPLE_ESP_WIFI_STA_AUTHMODE_THRESHOLD
        prompt "WiFi STA scan authentication threshold"
        default EXAMPLE_ESP_WIFI_STA_AUTHMODE_THRESHOLD_WPA2_PSK
        help
            Minimum authentication mode accepted when scanning and connecting as a station.
            Lower this to connect to older networks (WEP/WPA).

        config EXAMPLE_ESP_WIFI_STA_AUTHMODE_THRESHOLD_OPEN
            bool "Open"
        config EXAMPLE_ESP_WIFI_STA_AUTHMODE_THRESHOLD_WEP
            bool "WEP"
        config EXAMPLE_ESP_WIFI_STA_AUTHMODE_THRESHOLD_WPA_PSK
            bool "WPA PSK"
        config EXAMPLE_ESP_WIFI_STA_AUTHMODE_THRESHOLD_WPA2_PSK
            bool "WPA2 PSK"
        config EXAMPLE_ESP_WIFI_STA_AUTHMODE_THRESHOLD_WPA_WPA2_PSK
            bool "WPA/WPA2 PSK"
        config EXAMPLE_ESP_WIFI_STA_AUTHMODE_THRESHOLD_WPA3_PSK
            bool "WPA3 PSK"
    endchoice

    config EXAMPLE_ETH_GATEWAY_IP_ADDR
        string "Ethernet gateway IP address"
        default "192.168.5.1"
        help
            IP address for the Ethernet gateway (DHCP server).
            This is the static IP address assigned to the Ethernet interface.

    config EXAMPLE_ETH_GATEWAY_NETMASK
        string "Ethernet gateway netmask"
        default "255.255.255.0"
        help
            Subnet mask for the Ethernet gateway network.

    config EXAMPLE_ETH_GATEWAY_GW
        string "Ethernet gateway default gateway"
        default "192.168.5.1"
        help
            Default gateway IP address for the Ethernet gateway network.
            Typically set to the same IP as the gateway interface itself.

    config EXAMPLE_ETH_GATEWAY_DHCP_LEASE_TIME
        int "DHCP Lease Time"
        default 120
        help
            DHCP lease time in units of LWIP_DHCPS_LEASE_UNIT (default 60 seconds).
            Example: Setting this to 120 means a 7200-second (2 hour) lease time.
            Setting this to 1 means a 60-second lease time.

    config EXAMPLE_ETH_GATEWAY_DHCP_START_ADDR
        string "DHCP IP Pool Start Address"
        default "192.168.5.2"
        help
            Starting IP address of the DHCP address pool.
            This is the first IP address that will be assigned to DHCP clients.

    config EXAMPLE_ETH_GATEWAY_DHCP_END_ADDR
        string "DHCP IP Pool End Address"
        default "192.168.5.100"
        help
            Ending IP address of the DHCP address pool.
            This is the last IP address that will be assigned to DHCP clients.
            Maximum pool size is 100 addresses (DHCPS_MAX_LEASE).

    config EXAMPLE_ETH_GATEWAY_DHCP_ENABLE_DNS
        bool "Enable DNS in DHCP Offers"
        default y
        help
            Enable DNS server information in DHCP offers.
            When enabled, DHCP clients will receive DNS server addresses.
            If enabled, DNS can be configured to use WiFi STA's DNS servers.

    config EXAMPLE_ETH_GATEWAY_DHCP_DNS_MAIN
        string "Primary DNS Server"
        default "192.168.5.1"
        depends on EXAMPLE_ETH_GATEWAY_DHCP_ENABLE_DNS
        help
            Primary DNS server IP address to be provided to DHCP clients.
            Typically set to the gateway IP address or a public DNS server.
            Can be overridden to use WiFi STA's DNS if available.

    config EXAMPLE_ETH_GATEWAY_DHCP_DNS_BACKUP
        string "Backup DNS Server"
        default "8.8.8.8"
        depends on EXAMPLE_ETH_GATEWAY_DHCP_ENABLE_DNS
        help
            Backup DNS server IP address to be provided to DHCP clients.
            Typically set to a public DNS server like 8.8.8.8 (Google DNS).

endmenu
```
